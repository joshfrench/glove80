#include <behaviors.dtsi>
/* Include all behaviour includes needed */
#include <dt-bindings/zmk/outputs.h>
#include <dt-bindings/zmk/keys.h>
#include <dt-bindings/zmk/bt.h>
#include <dt-bindings/zmk/rgb.h>

#include "./helper.h"
#include "./keypos_glv80.h"

/* Automatically generated layer name #define */
#define LAYER_Base 0
#define LAYER_Num 1
#define LAYER_Func 2
#define LAYER_Magic 3

#define XXX &none
#define ___ &trans
#define HYPER LC(LS(LG(LALT)))

#define MO_TOG(layer) &mo_tog layer layer

/* left-hand HRMs */
ZMK_BEHAVIOR(hml, hold_tap,
    flavor = "balanced";
    tapping-term-ms = <250>;
    quick-tap-ms = <175>;                // repeat on tap-into-hold
    require-prior-idle-ms = <150>;
    bindings = <&kp>, <&kp>;
    hold-trigger-key-positions = <KEYS_R THUMBS>;
    hold-trigger-on-release;             // delay positional check until key-release
)

/* right-hand HRMs */
ZMK_BEHAVIOR(hmr, hold_tap,
    flavor = "balanced";
    tapping-term-ms = <250>;
    quick-tap-ms = <175>;                // repeat on tap-into-hold
    require-prior-idle-ms = <150>;
    bindings = <&kp>, <&kp>;
    hold-trigger-key-positions = <KEYS_L THUMBS>;
    hold-trigger-on-release;             // delay positional check until key-release
)

// tap: sticky shift | double tap: capsword | triple tap: capslock
ZMK_BEHAVIOR(ss_cw, tap_dance,
    tapping-term-ms = <200>;
    bindings = <&sk RSHFT>, <&caps_word>, <&kp CAPS>;
)

ZMK_BEHAVIOR(mo_tog, hold_tap,
    flavor = "hold-preferred";
    tapping-term-ms = <200>;
    bindings = <&mo>, <&tog>;
)

&caps_word {
    continue-list = <UNDERSCORE BACKSPACE DELETE MINUS LSHIFT RSHIFT>;
};

/ {
    macros {
        rgb_ug_status_macro: rgb_ug_status_macro {
            label = "RGB_UG_STATUS";
            compatible = "zmk,behavior-macro";
            #binding-cells = <0>;
            bindings
                = <&rgb_ug RGB_STATUS>;
        };

        bt_0: bt_0 {
            label = "BT_0";
            compatible = "zmk,behavior-macro";
            #binding-cells = <0>;
            bindings
                = <&out OUT_BLE>,
                  <&bt BT_SEL 0>;
        };

        bt_1: bt_1 {
            label = "BT_1";
            compatible = "zmk,behavior-macro";
            #binding-cells = <0>;
            bindings
                = <&out OUT_BLE>,
                  <&bt BT_SEL 1>;
        };

        bt_2: bt_2 {
            label = "BT_2";
            compatible = "zmk,behavior-macro";
            #binding-cells = <0>;
            bindings
                = <&out OUT_BLE>,
                  <&bt BT_SEL 2>;
        };

        bt_3: bt_3 {
            label = "BT_3";
            compatible = "zmk,behavior-macro";
            #binding-cells = <0>;
            bindings
                = <&out OUT_BLE>,
                  <&bt BT_SEL 3>;
        };
    };
};

/ {
    magic: magic {
        compatible = "zmk,behavior-hold-tap";
        label = "MAGIC_HOLD_TAP";
        #binding-cells = <2>;
        flavor = "tap-preferred";
        tapping-term-ms = <200>;
        bindings = <&mo>, <&rgb_ug_status_macro>;
    };
};

GLV80_LAYER(base,
/* ╭───────────────┬───────────────┬───────────────┬───────────────┬───────────────╮                                   ╭───────────────┬───────────────┬───────────────┬───────────────┬───────────────╮ */
    &kp C_BRI_DN    &kp C_BRI_UP    &kp C_PREV      &kp C_NEXT      &kp C_PP                                             &kp C_MUTE      &kp C_VOL_DN    &kp C_VOL_UP    &kp MINUS        XXX
/* ├───────────────┼───────────────┼───────────────┼───────────────┼───────────────┼───────────────╮   ╭───────────────┼───────────────┼───────────────┼───────────────┼───────────────┼───────────────┤ */
    &kp GRAVE       &kp N1          &kp N2          &kp N3          &kp N4          &kp N5              &kp N6           &kp N7          &kp N8          &kp N9          &kp N0          &kp EQUAL
/* ├───────────────┼───────────────┼───────────────┼───────────────┼───────────────┼───────────────┤   ├───────────────┼───────────────┼───────────────┼───────────────┼───────────────┼───────────────┤ */
    &kp TAB         &kp Q           &kp W           &kp E           &kp R           &kp T                &kp Y           &kp U           &kp I           &kp O           &kp P           &kp BSLH
/* ├───────────────┼───────────────┼───────────────┼───────────────┼───────────────┼───────────────┤   ├───────────────┼───────────────┼───────────────┼───────────────┼───────────────┼───────────────┤ */
    &mt LCTRL ESC   &hml LCTRL A    &hml LALT S     &hml LGUI D     &hml LSHFT F    &kp G                &kp H           &hmr RSHFT J    &hmr RGUI K     &hmr RALT L     &hmr RCTRL SEMI &kp SQT
/* ├───────────────┼───────────────┼───────────────┼───────────────┼───────────────┼───────────────┤   ├───────────────┼───────────────┼───────────────┼───────────────┼───────────────┼───────────────┤ */
    &mt LSHFT CAPS  &kp Z           &kp X           &kp C           &kp V           &kp B            ,   &kp N           &kp M           &kp COMMA       &kp DOT         &kp FSLH        &kp RSHFT
/* ├───────────────┼───────────────┼───────────────┼───────────────┼───────────────┼───────────────╯   ╰───────────────┼───────────────┼───────────────┼───────────────┼───────────────┼───────────────┤ */
    &mo LAYER_Func  &magic LAYER_Magic 0 XXX        &kp LEFT        &kp RIGHT                        ,                   &kp DOWN        &kp UP          &kp LBKT        &kp RBKT        &mo LAYER_Func
/* ╰───────────────┴───────────────┴───────────────┴───────────────┴───────────────╯                                   ╰───────────────┴───────────────┴───────────────┴───────────────┴───────────────╯ */
                                                                                                     ,
/*                                         ╭───────────────┬───────────────┬───────────────╮                   ╭───────────────┬───────────────┬───────────────╮                                         */
                                          MO_TOG(LAYER_Num) &kp HYPER       &kp HOME                            &kp PG_UP        &kp HYPER       &ss_cw
/*                                         ├───────────────┼───────────────┼───────────────┤      */ , /*      ├───────────────┼───────────────┼───────────────┤                                         */
                                            &kp BSPC        &kp LCTRL       &kp END                             &kp PG_DN        &kp RET         &kp SPACE
/*                                         ╰───────────────┴───────────────┴───────────────╯                   ╰───────────────┴───────────────┴───────────────╯                                         */
)

GLV80_LAYER(num,
/* ╭───────────────┬───────────────┬───────────────┬───────────────┬───────────────╮                                   ╭───────────────┬───────────────┬───────────────┬───────────────┬───────────────╮ */
    ___             ___             ___             ___             ___                                                 ___             ___             ___             ___             ___
/* ├───────────────┼───────────────┼───────────────┼───────────────┼───────────────┼───────────────╮   ╭───────────────┼───────────────┼───────────────┼───────────────┼───────────────┼───────────────┤ */
    ___             ___             ___             ___             ___             ___                 ___             ___             ___             ___             ___             ___
/* ├───────────────┼───────────────┼───────────────┼───────────────┼───────────────┼───────────────┤   ├───────────────┼───────────────┼───────────────┼───────────────┼───────────────┼───────────────┤ */
    ___             ___             ___             ___             ___             ___                 ___             &kp N4          &kp N5          &kp N6          ___             ___
/* ├───────────────┼───────────────┼───────────────┼───────────────┼───────────────┼───────────────┤   ├───────────────┼───────────────┼───────────────┼───────────────┼───────────────┼───────────────┤ */
    ___             ___             ___             ___             ___             ___                 ___             &kp N1          &kp N2          &kp N3          ___             ___
/* ├───────────────┼───────────────┼───────────────┼───────────────┼───────────────┼───────────────┤   ├───────────────┼───────────────┼───────────────┼───────────────┼───────────────┼───────────────┤ */
    ___             ___             ___             ___             ___             ___              ,  ___             &kp N0          ___             ___             ___             ___
/* ├───────────────┼───────────────┼───────────────┼───────────────┼───────────────┼───────────────╯   ╰───────────────┼───────────────┼───────────────┼───────────────┼───────────────┼───────────────┤ */
    ___             ___             ___             ___             ___                              ,                  ___             ___             ___             ___             ___
/* ╰───────────────┴───────────────┴───────────────┴───────────────┴───────────────╯                                   ╰───────────────┴───────────────┴───────────────┴───────────────┴───────────────╯ */
                                                                                                     ,
/*                                         ╭───────────────┬───────────────┬───────────────╮                   ╭───────────────┬───────────────┬───────────────╮                                         */
                                            ___             ___             ___                                 ___             ___             ___
/*                                         ├───────────────┼───────────────┼───────────────┤      */ , /*      ├───────────────┼───────────────┼───────────────┤                                         */
                                            ___             ___             ___                                 ___             ___             ___
/*                                         ╰───────────────┴───────────────┴───────────────╯                   ╰───────────────┴───────────────┴───────────────╯                                         */
)


GLV80_LAYER(function,
/* ╭───────────────┬───────────────┬───────────────┬───────────────┬───────────────╮                                   ╭───────────────┬───────────────┬───────────────┬───────────────┬───────────────╮ */
    &kp F1          &kp F2          &kp F3          &kp F4          &kp F5                                              &kp F6          &kp F7          &kp F8          &kp F9          &kp F10
/* ├───────────────┼───────────────┼───────────────┼───────────────┼───────────────┼───────────────╮   ╭───────────────┼───────────────┼───────────────┼───────────────┼───────────────┼───────────────┤ */
    ___             ___             ___             ___             ___             ___                 ___             ___             ___             ___             ___             ___
/* ├───────────────┼───────────────┼───────────────┼───────────────┼───────────────┼───────────────┤   ├───────────────┼───────────────┼───────────────┼───────────────┼───────────────┼───────────────┤ */
    ___             ___             ___             ___             ___             ___                 ___             ___             ___             ___             ___             ___
/* ├───────────────┼───────────────┼───────────────┼───────────────┼───────────────┼───────────────┤   ├───────────────┼───────────────┼───────────────┼───────────────┼───────────────┼───────────────┤ */
    ___             ___             ___             ___             ___             ___                 ___             ___             ___             ___             ___             ___
/* ├───────────────┼───────────────┼───────────────┼───────────────┼───────────────┼───────────────┤   ├───────────────┼───────────────┼───────────────┼───────────────┼───────────────┼───────────────┤ */
    ___             ___             ___             ___             ___             ___              ,  ___             ___             ___             ___             ___             ___
/* ├───────────────┼───────────────┼───────────────┼───────────────┼───────────────┼───────────────╯   ╰───────────────┼───────────────┼───────────────┼───────────────┼───────────────┼───────────────┤ */
    ___             ___             ___             ___             ___                              ,                  ___             ___             ___             ___             ___
/* ╰───────────────┴───────────────┴───────────────┴───────────────┴───────────────╯                                   ╰───────────────┴───────────────┴───────────────┴───────────────┴───────────────╯ */
                                                                                                     ,
/*                                         ╭───────────────┬───────────────┬───────────────╮                   ╭───────────────┬───────────────┬───────────────╮                                         */
                                            ___             ___             ___                                 ___             ___             ___
/*                                         ├───────────────┼───────────────┼───────────────┤      */ , /*      ├───────────────┼───────────────┼───────────────┤                                         */
                                            ___             ___             ___                                 ___             ___             ___
/*                                         ╰───────────────┴───────────────┴───────────────╯                   ╰───────────────┴───────────────┴───────────────╯                                         */
)

GLV80_LAYER(magic,
/* ╭───────────────┬───────────────┬───────────────┬───────────────┬───────────────╮                                   ╭───────────────┬───────────────┬───────────────┬───────────────┬───────────────╮ */
    &bt BT_CLR      XXX             XXX             XXX              XXX                                                XXX             XXX             XXX             XXX             &bt BT_CLR_ALL
/* ├───────────────┼───────────────┼───────────────┼───────────────┼───────────────┼───────────────╮   ╭───────────────┼───────────────┼───────────────┼───────────────┼───────────────┼───────────────┤ */
    XXX             XXX             XXX             XXX             XXX             XXX                 XXX             XXX             XXX             XXX             XXX             XXX
/* ├───────────────┼───────────────┼───────────────┼───────────────┼───────────────┼───────────────┤   ├───────────────┼───────────────┼───────────────┼───────────────┼───────────────┼───────────────┤ */
    XXX             &rgb_ug RGB_SPI &rgb_ug RGB_SAI &rgb_ug RGB_HUI &rgb_ug RGB_BRI &rgb_ug RGB_TOG     XXX             XXX             XXX             XXX             XXX             XXX
/* ├───────────────┼───────────────┼───────────────┼───────────────┼───────────────┼───────────────┤   ├───────────────┼───────────────┼───────────────┼───────────────┼───────────────┼───────────────┤ */
    &bootloader     &rgb_ug RGB_SPD &rgb_ug RGB_SAD &rgb_ug RGB_HUD &rgb_ug RGB_BRD &rgb_ug RGB_EFF     XXX             XXX             XXX             XXX             XXX             &bootloader
/* ├───────────────┼───────────────┼───────────────┼───────────────┼───────────────┼───────────────┤   ├───────────────┼───────────────┼───────────────┼───────────────┼───────────────┼───────────────┤ */
    &sys_reset      XXX             XXX             XXX             XXX             XXX              ,  XXX             XXX             XXX             XXX             XXX             &sys_reset
/* ├───────────────┼───────────────┼───────────────┼───────────────┼───────────────┼───────────────╯   ╰───────────────┼───────────────┼───────────────┼───────────────┼───────────────┼───────────────┤ */
    XXX             XXX             XXX             XXX             XXX                              ,                  XXX             XXX             XXX             XXX             XXX
/* ╰───────────────┴───────────────┴───────────────┴───────────────┴───────────────╯                                   ╰───────────────┴───────────────┴───────────────┴───────────────┴───────────────╯ */
                                                                                                     ,
/*                                         ╭───────────────┬───────────────┬───────────────╮                   ╭───────────────┬───────────────┬───────────────╮                                         */
                                            &bt_2           &bt_3           XXX                                 XXX             XXX             XXX
/*                                         ├───────────────┼───────────────┼───────────────┤      */ , /*      ├───────────────┼───────────────┼───────────────┤                                         */
                                            &bt_0           &bt_1           &out OUT_USB                         XXX             XXX             XXX
/*                                         ╰───────────────┴───────────────┴───────────────╯                   ╰───────────────┴───────────────┴───────────────╯                                         */
)

/*
/ {
    keymap {
        compatible = "zmk,keymap";


        layer_Base {
            bindings = <
  &kp C_BRI_DN          &kp C_BRI_UP  &kp C_PREV  &kp C_NEXT   &kp C_PP                                                                                 &kp C_MUTE  &kp C_VOL_DN  &kp C_VOL_UP  &kp MINUS      &none
     &kp GRAVE                &kp N1      &kp N2      &kp N3     &kp N4  &kp N5                                                                 &kp N6      &kp N7        &kp N8        &kp N9     &kp N0  &kp EQUAL
       &kp TAB                 &kp Q       &kp W       &kp E      &kp R   &kp T                                                                  &kp Y       &kp U         &kp I         &kp O      &kp P   &kp BSLH
 &mt LCTRL ESC                 &kp A       &kp S       &kp D      &kp F   &kp G                                                                  &kp H       &kp J         &kp K         &kp L   &kp SEMI    &kp SQT
     &kp LSHFT                 &kp Z       &kp X       &kp C      &kp V   &kp B  &kp LGUI   &kp LALT  &kp HOME  &kp PG_UP  &kp RALT   &kp RGUI   &kp N       &kp M     &kp COMMA       &kp DOT   &kp FSLH  &kp RSHFT
         &mo 1  &magic LAYER_Magic 0  &caps_word    &kp LEFT  &kp RIGHT          &kp BSPC  &kp LCTRL   &kp END  &kp PG_DN   &kp RET  &kp SPACE            &kp DOWN        &kp UP      &kp LBKT   &kp RBKT      &mo 1
            >;
        };

        layer_Func {
            bindings = <
 &kp F1  &kp F2  &kp F3  &kp F4  &kp F5                                                                  &kp F6  &kp F7  &kp F8  &kp F9  &kp F10
 &trans  &trans  &trans  &trans  &trans  &trans                                                  &trans  &trans  &trans  &trans  &trans   &trans
 &trans  &trans  &trans  &trans  &trans  &trans                                                  &trans  &trans  &trans  &trans  &trans   &trans
 &trans  &trans  &trans  &trans  &trans  &trans                                                  &trans  &trans  &trans  &trans  &trans   &trans
 &trans  &trans  &trans  &trans  &trans  &trans  &trans  &trans  &trans  &trans  &trans  &trans  &trans  &trans  &trans  &trans  &trans   &trans
 &trans  &trans  &trans  &trans  &trans          &trans  &trans  &trans  &trans  &trans  &trans          &trans  &trans  &trans  &trans   &trans
            >;
        };

        layer_Magic {
            bindings = <
  &bt BT_CLR            &none            &none            &none            &none                                                                                  &none   &none   &none   &none  &bt BT_CLR_ALL
       &none            &none            &none            &none            &none            &none                                                         &none   &none   &none   &none   &none           &none
       &none  &rgb_ug RGB_SPI  &rgb_ug RGB_SAI  &rgb_ug RGB_HUI  &rgb_ug RGB_BRI  &rgb_ug RGB_TOG                                                         &none   &none   &none   &none   &none           &none
 &bootloader  &rgb_ug RGB_SPD  &rgb_ug RGB_SAD  &rgb_ug RGB_HUD  &rgb_ug RGB_BRD  &rgb_ug RGB_EFF                                                         &none   &none   &none   &none   &none     &bootloader
  &sys_reset            &none            &none            &none            &none            &none   &bt_2   &bt_3         &none   &none   &none   &none   &none   &none   &none   &none   &none      &sys_reset
       &none            &none            &none            &none            &none                    &bt_0   &bt_1  &out OUT_USB   &none   &none   &none           &none   &none   &none   &none           &to 4
            >;
        };

    };
};
*/
